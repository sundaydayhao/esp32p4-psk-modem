## main/Kconfig.projbuild
```kconfig
menu "PSK receiver hotspot"
    config PSK_AP_SSID
        string "Wi-Fi hotspot name"
        default "ESP32P4-PSK"
    config PSK_AP_PASSWORD
        string "WPA2 password (8 to 63 characters)"
        default "pskmodem32"
    config PSK_AP_CHANNEL
        int "Wi-Fi channel"
        range 1 13
        default 6
endmenu

menu "AP580 voice module"
    config PSK_AP580_UART_ENABLED
        bool "Enable external AP580 on UART1"
        default n
        help
            Enable after assigning the actual wiring. ESP32-P4's ES8311
            handles PSK audio; speech coding requires the external AP580.
    config PSK_AP580_TX_GPIO
        int "P4 UART TX GPIO (to AP580 RX)"
        range -1 54
        default -1
    config PSK_AP580_RX_GPIO
        int "P4 UART RX GPIO (from AP580 TX)"
        range -1 54
        default -1
    config PSK_AP580_UART_BAUD
        int "AP580 UART baud rate"
        range 9600 921600
        default 115200
    choice PSK_AP580_RATE
        prompt "AP580 transmit codec profile (must match physical module)"
        default PSK_AP580_RATE_600
        config PSK_AP580_RATE_600
            bool "600 bit/s"
        config PSK_AP580_RATE_1200
            bool "1200 bit/s"
        config PSK_AP580_RATE_2400
            bool "2400 bit/s"
    endchoice
endmenu
```

## sdkconfig.defaults
```kconfig
CONFIG_IDF_TARGET="esp32p4"
CONFIG_ESP32P4_REV_MIN_301=y
CONFIG_ESP_MAIN_TASK_STACK_SIZE=8192
CONFIG_LOG_DEFAULT_LEVEL_INFO=y
CONFIG_FREERTOS_HZ=1000
CONFIG_COMPILER_OPTIMIZATION_PERF=y
CONFIG_ESPTOOLPY_FLASHMODE_QIO=y
CONFIG_ESPTOOLPY_FLASHSIZE_16MB=y
CONFIG_ESPTOOLPY_FLASHSIZE="16MB"
CONFIG_PARTITION_TABLE_CUSTOM=y
CONFIG_PARTITION_TABLE_OFFSET=0x10000
CONFIG_PARTITION_TABLE_CUSTOM_FILENAME="partitions.csv"
CONFIG_PARTITION_TABLE_FILENAME="partitions.csv"
CONFIG_SPIRAM=y
CONFIG_SPIRAM_MODE_HEX=y
CONFIG_SPIRAM_SPEED_200M=y
CONFIG_SPIRAM_ALLOW_BSS_SEG_EXTERNAL_MEMORY=y
CONFIG_IDF_EXPERIMENTAL_FEATURES=y
CONFIG_LV_CONF_SKIP=y
CONFIG_LV_BUILD_EXAMPLES=n
CONFIG_LV_DEF_REFR_PERIOD=10
CONFIG_LV_USE_CLIB_MALLOC=y
CONFIG_LV_USE_CLIB_SPRINTF=y
CONFIG_LV_USE_CLIB_STRING=y
CONFIG_LV_USE_FLOAT=y
CONFIG_LV_USE_GESTURE_RECOGNITION=y
```
